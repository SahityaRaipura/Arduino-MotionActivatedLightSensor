const int trig_pin_1 = 13; //ultrasonic sensor 1
const int echo_pin_1 = 12;
const int trig_pin_2 = 10; //ultrasonic senor 2
const int echo_pin_2 = 9;
const int light = 11;

int door_range = 55; //width of the door
int count = 0, x=0;
int duration_1 = 0;
unsigned int distance_1 = 0;
int duration_2 = 0;
unsigned int distance_2 = 0;

void setup() {
  Serial.begin(9600);
  pinMode(trig_pin_1,OUTPUT);
  pinMode(echo_pin_1,INPUT);
  pinMode(trig_pin_2,OUTPUT);
  pinMode(echo_pin_2,INPUT);
  pinMode(light,OUTPUT);
  digitalWrite(light,LOW);
}

void loop() {
  digitalWrite(trig_pin_1, HIGH);
  digitalWrite(trig_pin_2, HIGH);
  delay(1000);
  digitalWrite(trig_pin_1, LOW);
  
  duration_1 = pulseIn(echo_pin_1,HIGH);
  distance_1 = duration_1*0.034/2;
  Serial.print("Distance");
  Serial.println(distance_1);
  int flag = 0;
  if((distance_1 < door_range ) && x == 0) {
    count=count+1; //counting the number of people that enter the room
    digitalWrite(trig_pin_2, LOW);
    flag = 1;
  }
  
  Serial.println("Count" + count);
  
  digitalWrite(trig_pin_2, LOW);
  
 
  duration_2 = pulseIn(echo_pin_2,HIGH);
  distance_2 = duration_2*0.034/2;
  Serial.println(distance_2);

  x = 0;
  if(!(distance_1 < door_range) && (distance_2 < door_range) && flag == 0) {
    count=count-1; //counting the number of people that leave the room
    digitalWrite(trig_pin_1, LOW);
    x = 1;
  }
  
  Serial.println("Count:" + count);
  if (count > 0) {//turns the lights on if there are one or more people in the room
    digitalWrite(light,HIGH);

  }
  else if (count==0) {//turns the lights off if there is no one in the room
    digitalWrite(light,LOW);
  }
}
